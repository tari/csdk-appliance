## ext/Config.in
```kconfig
source "$BR2_EXTERNAL_CSDK_APPLIANCE_PATH/package/ce-csdk/Config.in"
source "$BR2_EXTERNAL_CSDK_APPLIANCE_PATH/package/ez80-llvm/Config.in"
source "$BR2_EXTERNAL_CSDK_APPLIANCE_PATH/package/fasmg/Config.in"
```

## ext/configs/v86_defconfig
```kconfig
BR2_x86_pentium2=y
# Bootlin toolchain only needs to be downloaded, saving a lot of build time
BR2_TOOLCHAIN_EXTERNAL=y
BR2_TOOLCHAIN_EXTERNAL_BOOTLIN_X86_I686_GLIBC_STABLE=y
BR2_REPRODUCIBLE=y
BR2_TARGET_GENERIC_HOSTNAME="csdk-appliance"
BR2_TARGET_GENERIC_ISSUE=""
BR2_ROOTFS_OVERLAY="${BR2_EXTERNAL_CSDK_APPLIANCE_PATH}/rootfs-overlay"

BR2_ROOTFS_MERGED_USR=y
BR2_TARGET_GENERIC_ROOT_PASSWD="root"
BR2_LINUX_KERNEL=y
BR2_LINUX_KERNEL_USE_CUSTOM_CONFIG=y
BR2_LINUX_KERNEL_CUSTOM_CONFIG_FILE="board/qemu/x86/linux.config"
BR2_LINUX_KERNEL_CONFIG_FRAGMENT_FILES="${BR2_EXTERNAL_CSDK_APPLIANCE_PATH}/kernel.config"
BR2_LINUX_KERNEL_ZSTD=y
BR2_TARGET_ROOTFS_SQUASHFS=y
BF2_TARGET_ROOTFS_SQUASHFS4_ZSTD=y
BR2_TARGET_ROOTFS_TAR=n

# Be y2k38-ready
BR2_TIME_BITS_64=y
# No reason to harden compiled code, we run in a browser and are disposable
BR2_PIC_PIE=n
BR2_SSP_NONE=y
BR2_RELRO_NONE=y
BR2_FORTIFY_SOURCE_NONE=y

BR2_PACKAGE_MAKE=y
BR2_PACKAGE_UTIL_LINUX=y
BR2_PACKAGE_CE_CSDK=y
BR2_PACKAGE_EZ80_LLVM=y
BR2_PACKAGE_FASMG=y
BR2_PACKAGE_BUILDSERVER=y
```

## ext/package/buildserver/Config.in
```kconfig
config BR2_PACKAGE_BUILDSERVER
    bool "CE compiler server"
    select BR2_PACKAGE_CE_CSDK
    select BR2_PACKAGE_PYTHON3
```

## ext/package/ce-csdk/Config.in
```kconfig
config BR2_PACKAGE_CE_CSDK
    bool "CE toolchain"
    help
      Install the TI-CE C/C++ toolchain.

      https://ce-programming.github.io/toolchain/
```

## ext/package/csdk-server/Config.in
```kconfig
config BR2_PACKAGE_CSDK_SERVER
    bool "CE compiler server"
    select BR2_PACKAGE_CE_CSDK
    select BR2_PACKAGE_PYTHON3
```

## ext/package/ez80-llvm/Config.in
```kconfig
config BR2_PACKAGE_EZ80_LLVM
    bool "LLVM tools targeting eZ80"
    depends on BR2_INSTALL_LIBSTDCPP
```

## ext/package/fasmg/Config.in
```kconfig
config BR2_PACKAGE_FASMG
    bool "Flat assembler G"
    help
      Install flat assembler g
```
